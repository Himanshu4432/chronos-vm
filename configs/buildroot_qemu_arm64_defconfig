## configs/buildroot_qemu_arm64_defconfig
```kconfig
# Minimal Buildroot configuration for aarch64 guest rootfs
BR2_aarch64=y
BR2_cortex_a53=y
BR2_TOOLCHAIN_BUILDROOT_WCHAR=y
BR2_TOOLCHAIN_BUILDROOT_CXX=y
BR2_ROOTFS_DEVICE_CREATION_DYNAMIC_MDEV=y
BR2_SYSTEM_DHCP="eth0"
BR2_TARGET_ROOTFS_EXT2=y
BR2_TARGET_ROOTFS_EXT2_4=y
# Enable openssh for remote login
BR2_PACKAGE_OPENSSH=y
# Enable standard toolchains
BR2_PACKAGE_HOST_QEMU=y
BR2_PACKAGE_HOST_QEMU_SYSTEM=y
```

## configs/linux_qemu_arm64_defconfig
```kconfig
# Linux Kernel configurations containing KVM and TEE mediator support
CONFIG_ARM64=y
CONFIG_KVM=y
CONFIG_VIRTUALIZATION=y
CONFIG_TEE=y
CONFIG_OPTEE=y
CONFIG_TEE_MEDIATOR=y
CONFIG_OPTEE_MEDIATOR=y
CONFIG_ARM_GIC=y
CONFIG_ARM_GIC_V3=y
CONFIG_NET_9P=y
CONFIG_NET_9P_VIRTIO=y
CONFIG_9P_FS=y
```

## configs/u-boot_qemu_arm64_defconfig
```kconfig
# U-Boot config for virtualized arm64 QEMU target
CONFIG_ARM=y
CONFIG_TARGET_QEMU_ARM_64BIT=y
CONFIG_AHCI=y
CONFIG_DISTRO_DEFAULTS=y
CONFIG_SYS_TEXT_BASE=0x00000000
CONFIG_BOOTDELAY=2
CONFIG_USE_BOOTARGS=y
CONFIG_BOOTARGS="console=ttyAMA0 earlycon=pl011,0x9000000 root=/dev/vda rw"
```
